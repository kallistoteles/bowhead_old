## config/boards/sheilds/bowhead/Kconfig.shield
```kconfig
# Copyright (c) 2020 Pete Johanson, Kurtis Lew
# SPDX-License-Identifier: MIT

config SHIELD_BOWHEAD_LEFT
	def_bool $(shields_list_contains,bowhead_left)

config SHIELD_BOWHEAD_RIGHT
	def_bool $(shields_list_contains,bowhead_right)
```

## config/boards/shields/bowhead/Kconfig.defconfig
```kconfig
# Copyright (c) 2020 Pete Johanson, Kurtis Lew
# SPDX-License-Identifier: MIT

config ZMK_BLE
	default y

config ZMK_USB
	default y

if SHIELD_BOWHEAD_LEFT

config ZMK_KEYBOARD_NAME
	default "bowhead"

config ZMK_SPLIT_BLE_ROLE_CENTRAL
	default y

endif

if SHIELD_BOWHEAD_LEFT || SHIELD_BOWHEAD_RIGHT

config ZMK_SPLIT
	default y

endif
```

## config/west.yml
```yaml
manifest:
  remotes:
    - name: kallistoteles
      url-base: https://github.com/kallistoteles
  projects:
    - name: zmk-iris
      remote: kallistoteles
      revision: main
      import: app/west.yml
  self:
    path: config
```
